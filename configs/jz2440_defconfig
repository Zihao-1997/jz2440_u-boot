## configs/jz2440_defconfig
```kconfig
CONFIG_ARM=y
CONFIG_TARGET_JZ2440=y
CONFIG_DM=n
CONFIG_SYS_PROMPT="JZ2440 # "
CONFIG_SYS_TEXT_BASE=0x33F00000
CONFIG_S3C24X0_SERIAL=y
CONFIG_BOARD_EARLY_INIT_F=y
CONFIG_MTD=y
CONFIG_MTD_RAW_NAND=y
CONFIG_NAND_S3C2440=y
CONFIG_S3C2440_NAND_HWECC=y
# CONFIG_CMD_SETEXPR is not set
```
